## boards/shields/lily58/Kconfig.defconfig
```kconfig
if SHIELD_MY_KEYBOARD_LEFT

config ZMK_KEYBOARD_NAME
    default "LilySrnk"

config ZMK_SPLIT_ROLE_CENTRAL
    default y

endif

if SHIELD_LILY58_LEFT || SHIELD_LILY58_RIGHT

config ZMK_SPLIT
    default y

endif
```
